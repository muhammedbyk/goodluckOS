## rootfs/package/are-you-sure/Config.in
```kconfig
config BR2_PACKAGE_ARE_YOU_SURE
	bool "are-you-sure"
	depends on BR2_INSTALL_LIBSTDCPP
	select BR2_PACKAGE_SDL2
	select BR2_PACKAGE_IMGUI
	select BR2_PACKAGE_ALSA_LIB
	help
	  Are You Sure Script Launcher Application

comment "are-you-sure needs a toolchain w/ C++"
	depends on !BR2_INSTALL_LIBSTDCPP
```
